## drivers/soc/rockchip/Kconfig
```kconfig
# SPDX-License-Identifier: GPL-2.0-only
if ARCH_ROCKCHIP || COMPILE_TEST

#
# Rockchip Soc drivers
#

config ROCKCHIP_CPUINFO
        bool "Rockchip cpuinfo support"
        depends on (ROCKCHIP_EFUSE || ROCKCHIP_OTP) && (ARM64 || ARM)
        default y
        help
          Say y here to enable Rockchip cpuinfo support.
          Set system_serial_low/high from eFuse ID.
          Serial can read from /proc/cpuinfo.

          If unsure, say N.

config ROCKCHIP_GRF
	bool
	default y
	help
	  The General Register Files are a central component providing
	  special additional settings registers for a lot of soc-components.
	  In a lot of cases there also need to be default settings initialized
	  to make some of them conform to expectations of the kernel.

config ROCKCHIP_IODOMAIN
	tristate "Rockchip IO domain support"
	depends on OF
	help
	  Say y here to enable support io domains on Rockchip SoCs. It is
	  necessary for the io domain setting of the SoC to match the
	  voltage supplied by the regulators.

config ROCKCHIP_PM_DOMAINS
        bool "Rockchip generic power domain"
        depends on PM
        select PM_GENERIC_DOMAINS
        help
          Say y here to enable power domain support.
          In order to meet high performance and low power requirements, a power
          management unit is designed or saving power when RK3288 in low power
          mode. The RK3288 PMU is dedicated for managing the power of the whole chip.

          If unsure, say N.

config ROCKCHIP_PVTM
        bool "Rockchip PVTM support"
        help
          Say y here to enable pvtm support.
          The Process-Voltage-Temperature Monitor (PVTM) is used to monitor
          the chip performance variance caused by chip process, voltage and
          temperature.

config ROCKCHIP_VENDOR_STORAGE_UPDATE_LOADER
        bool "Rockchip vendor storage update loader support"
        default n
        help
          Say y here to enable rockchip vendor storage update loader support.
          The /dev/vendor_storage must set root user access only.

config ROCKCHIP_MTD_VENDOR_STORAGE
	bool "Rockchip mtd vendor storage support"
	depends on MTD
	default y
	help
	  Say y here to enable rockchip mtd vendor storage support.

endif
```
